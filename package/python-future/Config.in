## package/python-future/Config.in
```kconfig
config BR2_PACKAGE_PYTHON_FUTURE
	bool "python-future"
	depends on BR2_PACKAGE_PYTHON || BR2_PACKAGE_PYTHON3
	help
	  Easy, clean, reliable Python 2/3 compatibility.

	  http://python-future.org

if BR2_PACKAGE_PYTHON_FUTURE

config BR2_PACKAGE_HOST_PYTHON_FUTURE
	bool "host python-future"
	help
	  Install python-future on host.

endif
```
